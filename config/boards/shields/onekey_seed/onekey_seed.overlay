/*
 * Copyright (c) 2022-2023 alin m elena
 * SPDX-License-Identifier: MIT
 */

#include <dt-bindings/zmk/matrix_transform.h>

/ {
   model = "onekey, rev1";

   compatible = "mlego", "seeduino,xiao_ble";

   chosen {
     zmk,kscan = &kscan;
   };

   kscan: kscan {
     compatible = "zmk,kscan-gpio-matrix";
     label = "kscan";
     diode-direction = "col2row";
     col-gpios =  <&xiao_d 0(GPIO_ACTIVE_HIGH | GPIO_PULL_DOWN)>
                 ;
     row-gpios =   <&xiao_d 1(GPIO_ACTIVE_HIGH | GPIO_PULL_DOWN)>
                 ;
   };

};
