## config/boards/shields/boardsource4x12/Kconfig.defconfig
```kconfig
# Copyright (c) 2021 The ZMK Contributors
# SPDX-License-Identifier: MIT

if SHIELD_BOARDSOURCE4X12

config ZMK_KEYBOARD_NAME
    default "boardsource4x12"

endif
```

## config/boards/shields/boardsource4x12/Kconfig.shield
```kconfig
# Copyright (c) 2021 The ZMK Contributors
# SPDX-License-Identifier: MIT

config SHIELD_BOARDSOURCE4X12
    def_bool $(shields_list_contains,boardsource4x12)
```

## config/boards/shields/mlego2x2/Kconfig.defconfig
```kconfig
# Copyright (c) 2022 The ZMK Contributors
# SPDX-License-Identifier: MIT

if SHIELD_MLEGO2x2_REV1

config ZMK_KEYBOARD_NAME
    default "mlego m2x2 rev1"

config SPI
	default y

if ZMK_RGB_UNDERGLOW

config WS2812_STRIP

  default y

endif

if ZMK_DISPLAY

config I2C
  default y

config SSD1306
  default y

config SSD1306_REVERSE_MODE
  default y

config ZMK_DISPLAY_BLANK_ON_IDLE
  default y

endif # ZMK_DISPLAY

if LVGL

config LVGL_VDB_SIZE
  default 100

config LVGL_DPI
  default 148

config LVGL_BITS_PER_PIXEL
	default 1

choice LVGL_COLOR_DEPTH
  default LVGL_COLOR_DEPTH_1
endchoice

endif # LVGL


endif # SHIELD_MLEGO2x2
```

## config/boards/shields/mlego2x2/Kconfig.shield
```kconfig
# Copyright (c) 2022 The ZMK Contributors
# SPDX-License-Identifier: MIT

config SHIELD_MLEGO2x2_REV1
   def_bool $(shields_list_contains,mlego2x2_rev1)
```

## config/boards/shields/mlego2x2_rev2/Kconfig.defconfig
```kconfig
# Copyright (c) 2022 The ZMK Contributors
# SPDX-License-Identifier: MIT

if SHIELD_MLEGO2x2_REV2

config ZMK_KEYBOARD_NAME
    default "mlego m2x2 rev2"

config SPI
	default y

if ZMK_RGB_UNDERGLOW

config WS2812_STRIP

  default y

endif

if ZMK_DISPLAY

config I2C
  default y

config SSD1306
  default y

config SSD1306_REVERSE_MODE
  default y

config ZMK_DISPLAY_BLANK_ON_IDLE
  default y

endif # ZMK_DISPLAY

if LVGL

config LV_Z_VDB_SIZE
  default 64

config LV_Z_DPI
  default 148

config LV_Z_BITS_PER_PIXEL
	default 1

choice LV_COLOR_DEPTH
  default LV_COLOR_DEPTH_1
endchoice

endif # LVGL

endif # SHIELD_MLEGO2x2
```

## config/boards/shields/mlego2x2_rev2/Kconfig.shield
```kconfig
# Copyright (c) 2022 The ZMK Contributors
# SPDX-License-Identifier: MIT

config SHIELD_MLEGO2x2_REV2
   def_bool $(shields_list_contains,mlego2x2_rev2)
```

## config/boards/shields/mlego5x13_61_r8/Kconfig.defconfig
```kconfig
# Copyright (c) 2022 The ZMK Contributors
# SPDX-License-Identifier: MIT

if SHIELD_MLEGO5x13_61_REV8

config ZMK_KEYBOARD_NAME
    default "mlego5x13 61 r8"

config SPI
	default y

endif 
```

## config/boards/shields/mlego5x13_61_rev8/Kconfig.defconfig
```kconfig
# Copyright (c) 2022 The ZMK Contributors
# SPDX-License-Identifier: MIT

if SHIELD_MLEGO5x13_61_REV8

config ZMK_KEYBOARD_NAME
    default "mlego m5x13 61 rev8"

config SPI
	default y

endif 
```

## config/boards/shields/mlego5x13_61_rev8/Kconfig.shield
```kconfig
# Copyright (c) 2022 The ZMK Contributors
# SPDX-License-Identifier: MIT

config  SHIELD_MLEGO5x13_61_REV8
   def_bool $(shields_list_contains,mlego5x13_61_rev8)
```

## config/boards/shields/mlego5x13_rev4/Kconfig.defconfig
```kconfig
# Copyright (c) 2022 The ZMK Contributors
# SPDX-License-Identifier: MIT

if SHIELD_MLEGO5X13

config ZMK_KEYBOARD_NAME
    default "mlego5x13"

endif

if BUILD_OUTPUT_UF2

config BUILD_OUTPUT_UF2_USE_FLASH_BASE
    default y

config BUILD_OUTPUT_UF2_USE_FLASH_OFFSET
    default y

endif # BUILD_OUTPUT_UF2

if ZMK_RGB_UNDERGLOW

config WS2812_STRIP

	default y

endif

if ZMK_DISPLAY

config I2C
	default y

config SSD1306
	default y

config SSD1306_REVERSE_MODE
	default y

endif # ZMK_DISPLAY

if LVGL

config LVGL_VDB_SIZE
	default 64

config LVGL_DPI
	default 148

config LVGL_BITS_PER_PIXEL
	default 1

choice LVGL_COLOR_DEPTH
	default LVGL_COLOR_DEPTH_1
endchoice

endif # LVGL
```

## config/boards/shields/mlego5x13_rev4/Kconfig.shield
```kconfig
# Copyright (c) 2022 The ZMK Contributors
# SPDX-License-Identifier: MIT

config SHIELD_MLEGO5X13
    def_bool $(shields_list_contains,mlego5x13)

config USB_DEVICE_PID
	default 0x6361
config USB_DEVICE_VID
	default 0xBABA
```

## config/boards/shields/mlego5x13_rev5/Kconfig.defconfig
```kconfig
# Copyright (c) 2022 The ZMK Contributors
# SPDX-License-Identifier: MIT
if SHIELD_MLEGO5X13_REV5

if ZMK_RGB_UNDERGLOW

config WS2812_STRIP_GPIO
  default y

endif

if ZMK_DISPLAY

config I2C
  default y

config SSD1306
  default y

config ZMK_DISPLAY_BLANK_ON_IDLE
  default y

endif # ZMK_DISPLAY

if LVGL

config LV_Z_VDB_SIZE
  default 64

config LV_DPI_DEF
  default 148

config LV_Z_BITS_PER_PIXEL
	default 1

choice LV_COLOR_DEPTH
  default LV_COLOR_DEPTH_1
endchoice

endif # LVGL
endif 
```

## config/boards/shields/mlego5x13_rev5/Kconfig.shield
```kconfig
# Copyright (c) 2022 The ZMK Contributors
# SPDX-License-Identifier: MIT

config SHIELD_MLEGO5X13_REV5
    def_bool $(shields_list_contains,mlego5x13_rev5)
```

## config/boards/shields/mlego5x13_rev7/Kconfig.defconfig
```kconfig
# Copyright (c) 2022 The ZMK Contributors
# SPDX-License-Identifier: MIT

if SHIELD_MLEGO5x13_REV7

config ZMK_KEYBOARD_NAME
    default "mlego m5x13 rev7"

config SPI
	default y
endif 
```

## config/boards/shields/mlego5x13_rev7/Kconfig.shield
```kconfig
# Copyright (c) 2022 The ZMK Contributors
# SPDX-License-Identifier: MIT

config  SHIELD_MLEGO5x13_REV7
   def_bool $(shields_list_contains,mlego5x13_rev7)
```

## config/boards/shields/mlego5x13_rev8/Kconfig.defconfig
```kconfig
# Copyright (c) 2022 The ZMK Contributors
# SPDX-License-Identifier: MIT

if SHIELD_MLEGO5x13_REV8

config ZMK_KEYBOARD_NAME
    default "mlego 5x13 r8"

config SPI
	default y

endif 
```

## config/boards/shields/mlego_m66_rev4/Kconfig.defconfig
```kconfig
# Copyright (c) 2022-2024 The ZMK Contributors
# SPDX-License-Identifier: MIT

if SHIELD_MLEGO_M66_REV4 || SHIELD_MLEGO_M66_REV4_LS011B7DH03 || SHIELD_MLEGO_M66_REV4_LS013B7DH03 || SHIELD_MLEGO_M66_REV4_LS013B7DH05 || SHIELD_MLEGO_M66_REV4_EINK154 || SHIELD_MLEGO_M66_REV4_EINK213

config ZMK_KEYBOARD_NAME
    default "mlego r4 60x168" if SHIELD_MLEGO_M66_REV4_LS011B7DH03
    default "mlego r4 128x128" if SHIELD_MLEGO_M66_REV4_LS013B7DH03
    default "mlego r4 144x168" if SHIELD_MLEGO_M66_REV4_LS013B7DH05
    default "mlego r4 eink154" if SHIELD_MLEGO_M66_REV4_EINK154
    default "mlego r4 eink213" if SHIELD_MLEGO_M66_REV4_EINK213
    default "mlego m66 r4" 

config SPI
	default y

config ZMK_DISPLAY
	select LV_USE_CONT
	select LV_FONT_MONTSERRAT_26

if ZMK_DISPLAY

config SYSTEM_WORKQUEUE_STACK_SIZE
    default 2048

config LV_Z_MEM_POOL_SIZE
     default 4096

choice LV_FONT_DEFAULT
    default LV_FONT_DEFAULT_MONTSERRAT_26

endchoice

choice ZMK_DISPLAY_WORK_QUEUE
    default ZMK_DISPLAY_WORK_QUEUE_DEDICATED
endchoice


config ZMK_DISPLAY_DEDICATED_THREAD_STACK_SIZE
    default 4096

config ZMK_DISPLAY_DEDICATED_THREAD_PRIORITY
    default 10

choice ZMK_LV_FONT_DEFAULT_SMALL
    default ZMK_LV_FONT_DEFAULT_SMALL_MONTSERRAT_26

endchoice

config LS0XX
	default y if SHIELD_MLEGO_M66_REV4_LS011B7DH03
	default y if SHIELD_MLEGO_M66_REV4_LS013B7DH03
	default y if SHIELD_MLEGO_M66_REV4_LS013B7DH05
  default n 

config LV_Z_BITS_PER_PIXEL
	default 1

choice LV_COLOR_DEPTH
	default LV_COLOR_DEPTH_1

endchoice

config LV_DPI_DEF
	default 161 if SHIELD_MLEGO_M66_REV4_EINK154
	default 161 if SHIELD_MLEGO_M66_REV4_EINK213
	default 161 if SHIELD_MLEGO_M66_REV4_LS011B7DH03
  default 142 if SHIELD_MLEGO_M66_REV4_LS013B7DH03
  default 161 

config LV_Z_VDB_SIZE
	default 100

config ZMK_DISPLAY_STATUS_SCREEN_CUSTOM
   imply MLEGO_WIDGET_STATUS

config MLEGO_BONGO_CAT
   bool "enable bongo cat on th widgt"
   imply MLEGO_WIDGET_STATUS
   select ZMK_WPM
   select LVGL_USE_ANIMATION
  
config MLEGO_WIDGET_STATUS
    bool "Custom mlego status widget"
    select LV_FONT_MONTSERRAT_16
    select LV_FONT_MONTSERRAT_14
    select LV_FONT_MONTSERRAT_18
    select LV_USE_IMG
    select LV_USE_CANVAS

config MLEGO_BONGO_CAT_IDLE_LIMIT
    int "Upper limit for WPM for showing idle animation"
    default 30

config MLEGO_BONGO_CAT_SLOW_LIMIT
    int "Upper limit for WPM for showing slow typing image"
    default 60

config MIP_WIDTH
   int "width of the mip, sharp, memory display"
   default 160

config MIP_HEIGHT
   int "height of the mip, sharp, memory display"
   default 68

config MIP_CANVAS
   int "canvas size of the mip, sharp, memory display"
   default 68

config MIP_ROTATE
   int "angle to rotate elements in screen mip, sharp, memory display in units of 0.1"
   default 0


endif # ZMK_DISPLAY

endif # MLEGO_M66_REV4
```

## config/boards/shields/mlego_m66_rev4/Kconfig.shield
```kconfig
# Copyright (c) 2022-2024 The ZMK Contributors
# SPDX-License-Identifier: MIT

config  SHIELD_MLEGO_M66_REV4
   def_bool $(shields_list_contains,mlego_m66_rev4)

config  SHIELD_MLEGO_M66_REV4_RP2040
   def_bool $(shields_list_contains,mlego_m66_rev4_rp2040)


config  SHIELD_LS013B7DH03
   def_bool $(shields_list_contains,ls013b7dh03s)

config  SHIELD_LS013B7DH05
   def_bool $(shields_list_contains,ls013b7dh05)

config  SHIELD_LS011B7DH03
   def_bool $(shields_list_contains,ls011b7dh03)

config  SHIELD_WEACT_EINK_154
   def_bool $(shields_list_contains,weact_eink_154)

config  SHIELD_WEACT_EINK_213
   def_bool $(shields_list_contains,weact_eink_213)

config  SHIELD_ST7735
   def_bool $(shields_list_contains,st7735)
```

## config/boards/shields/mlego_rev8/Kconfig.shield
```kconfig
# Copyright (c) 2022 The ZMK Contributors
# SPDX-License-Identifier: MIT

config  SHIELD_MLEGO5x13_REV8
   def_bool $(shields_list_contains,mlego5x13_rev8)
```

## config/boards/shields/onekey/Kconfig.defconfig
```kconfig
# Copyright (c) 2022 The ZMK Contributors
# SPDX-License-Identifier: MIT

if SHIELD_ONEKEY

config ZMK_KEYBOARD_NAME
    default "onekey"
endif
```

## config/boards/shields/onekey_seed/Kconfig.shield
```kconfig
# Copyright (c) 2022 The ZMK Contributors
# SPDX-License-Identifier: MIT

config  SHIELD_ONEKEY
   def_bool $(shields_list_contains,onekey)
```

## config/boards/shields/onekey_sharp/Kconfig.shield
```kconfig
# Copyright (c) 2022 The ZMK Contributors
# SPDX-License-Identifier: MIT

config  SHIELD_ONEKEY_SHARP
   def_bool $(shields_list_contains,onekey_sharp)
```

## config/west.yml
```yaml
manifest:
  remotes:
    - name: zmk
      url-base: https://github.com/zmkfirmware
    - name: caksoylar
      url-base: https://github.com/caksoylar
    - name: urob
      url-base: https://github.com/urob
  projects:
    - name: zmk
      remote: zmk
      revision: main
      import: app/west.yml
    - name: zmk-rgbled-widget
      remote: caksoylar
      revision: main
    - name: zmk-helpers
      remote: urob
      revision: v2 # this will eventually become main
  self:
    path: config
```
