/*
 * Copyright (c) 2022-2023 alin m elena
 * SPDX-License-Identifier: MIT
 */

#include <dt-bindings/zmk/matrix_transform.h>

/ {

   kscan: kscan {
     compatible = "zmk,kscan-gpio-matrix";
     diode-direction = "col2row";
     col-gpios =  <&xiao_d 0(GPIO_ACTIVE_HIGH | GPIO_PULL_DOWN)>
                 ;
     row-gpios =   <&xiao_d 1(GPIO_ACTIVE_HIGH | GPIO_PULL_DOWN)>
                 ;
   };

};
