/*
 * Copyright (c) 2022-2023 alin m elena
 * SPDX-License-Identifier: MIT
 */

#include <dt-bindings/zmk/matrix_transform.h>

/ {
   kscan: kscan {
     compatible = "zmk,kscan-gpio-matrix";
     label = "kscan";
     diode-direction = "col2row";
     col-gpios =  <&gpio0 0 (GPIO_ACTIVE_HIGH | GPIO_PULL_DOWN)>
                 ;
     row-gpios =   <&gpio0 1  (GPIO_ACTIVE_HIGH | GPIO_PULL_DOWN)>
                 ;
   };

};
