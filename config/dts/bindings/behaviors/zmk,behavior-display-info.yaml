## config/dts/bindings/behaviors/zmk,behavior-display-info.yaml
```yaml
# Copyright (c) 2024 The ZMK Contributors
# SPDX-License-Identifier: MIT

description: Display Info Behavior

compatible: "zmk,behavior-display-info"

include: zero_param.yaml
```
